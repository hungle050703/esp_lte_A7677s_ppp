## main/Kconfig.projbuild
```kconfig
menu "LTE Modem Configuration"

    config MODEM_TX_PIN
        int "ESP32 TX Pin (GPIO4)"
        default 4

    config MODEM_RX_PIN
        int "ESP32 RX Pin (GPIO2)"
        default 2

    config MODEM_PWRKEY_PIN
        int "Modem PWRKEY Pin (GPIO13)"
        default 13

    config MODEM_RST_PIN
        int "Modem RESET Pin (GPIO15)"
            default 15

    config MODEM_APN
        string "Provider APN"
        default "v-internet"
        help
            APN name for your cellular provider (e.g., m-wap for Mobifone, v-internet for Viettel, m9-wintel for Wintel)

endmenu
```

## sdkconfig.defaults
```kconfig
CONFIG_PPP_SUPPORT=y
CONFIG_PPP_NOTIFY_PHASE_SUPPORT=y
CONFIG_PPP_PAP_SUPPORT=y
CONFIG_PPP_CHAP_SUPPORT=y
```
